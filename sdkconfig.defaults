## sdkconfig.defaults
```kconfig
# WiFi Configuration (Disabled by default)
CONFIG_ESP_WIFI_ENABLED=n
CONFIG_ESP32_WIFI_ENABLED=n
CONFIG_WIFI_ENABLED=n

# LVGL Configuration
CONFIG_LV_CONF_SKIP=y
CONFIG_LV_USE_OBSERVER=y
CONFIG_LV_USE_SYSMON=y
CONFIG_LV_FONT_MONTSERRAT_12=y
CONFIG_LV_FONT_MONTSERRAT_14=y
CONFIG_LV_FONT_MONTSERRAT_18=y
CONFIG_LV_FONT_MONTSERRAT_20=y
CONFIG_LV_FONT_MONTSERRAT_24=y
CONFIG_LV_FONT_MONTSERRAT_32=y
CONFIG_LV_FONT_MONTSERRAT_48=y

# LCD & Touch Configuration
CONFIG_LCD_CONTROLLER_ILI9341=y
CONFIG_LCD_TOUCH_ENABLED=y
CONFIG_LCD_TOUCH_CONTROLLER_XPT2046=y
CONFIG_LCD_MIRROR_Y=1
CONFIG_XPT2046_Z_THRESHOLD=400
CONFIG_XPT2046_CONVERT_ADC_TO_COORDS=y

# Partition Table
CONFIG_PARTITION_TABLE_SINGLE_APP=n
CONFIG_PARTITION_TABLE_CUSTOM=y

# Bluetooth NimBLE
CONFIG_BT_ENABLED=y
CONFIG_BT_NIMBLE_ENABLED=y
CONFIG_BT_MODE_BLE=y
```

## sdkconfig.defaults.esp32c6
```kconfig
CONFIG_IDF_TARGET="esp32c6"
CONFIG_ESPTOOLPY_FLASHSIZE_8MB=y
CONFIG_ESPTOOLPY_FLASHSIZE="8MB"
CONFIG_PARTITION_TABLE_CUSTOM_FILENAME="partitions_esp32c6.csv"
```
